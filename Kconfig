## Kconfig
```kconfig
#
# Copyright (c) 2022 Dhruva Gole
#
# SPDX-License-Identifier: Apache-2.0
#

config ARDUINO_API
	bool "ARDUINO_API"
	imply CPP
	imply GPIO
	imply I2C
	imply NEWLIB_LIBC_FLOAT_PRINTF
	imply CBPRINTF_FP_SUPPORT
	imply RING_BUFFER
	select UART_INTERRUPT_DRIVEN
	default n

if ARDUINO_API

config QEMU_ICOUNT
	bool "QEMU icount mode"
	default n
	depends on QEMU_TARGET

config ARDUINO_API_SERIAL_BUFFER_SIZE
	int "Buffer size for Arduino Serial API"
	default 64

config ARDUINO_ENTRY
	bool "Provide arduino setup and loop entry points"
	default y

config ARDUINO_MAX_TONES
	int "Maximum number of tones that can be played simultaneously with tone()"
	default -1
	help
	  Specify the maximum number of tones that can be played simultaneously with tone().
	  If set to -1 (or any other negative value), the maximum number will be
	  determined from the system's digital pin configuration.

endif

if USB_DEVICE_STACK_NEXT

config USB_DEVICE_PRODUCT
	string "USB Device Product"
	default "Arduino Generic board"

config USB_DEVICE_MANUFACTURER
	string "USB Device Manufacturer"
	default "Arduino"

config USB_DEVICE_VID
	hex "USB Device Vendor ID"
	default 0x2341

config USB_DEVICE_PID
	hex "USB Device Product ID"
	default 0x0001

config ARDUINO_USB_LOADER_OWNED
	bool "USB device is brought up and owned by the loader"
	default n
	help
	  On targets where the loader (not the sketch) owns the USB device --
	  e.g. the in-process CDC upload/swap loader for SoCs with no
	  sys_reboot (BCM2710 / Raspberry Pi Zero 2 W) -- the loader brings
	  USBD up at boot and keeps it up across sketch reloads. With this
	  set, the sketch's SerialUSB_ attaches to the already-up CDC ACM
	  device (configure + RX-enable only) instead of re-initialising and
	  re-enabling USBD, and the sketch-side 1200-bps reset path is
	  compiled out (the loader handles the upload touch). Default n keeps
	  every other board's behaviour unchanged.

endif
```

## loader/Kconfig
```kconfig
#
# Copyright (c) Arduino s.r.l. and/or its affiliated companies
#
# SPDX-License-Identifier: Apache-2.0
#

config PINCTRL
	select PINCTRL_NON_STATIC

source "Kconfig.zephyr"

config LLEXT_HEAP_REGION
	string "LLEXT heap memory region"
	depends on CODE_DATA_RELOCATION
	help
	  Specify the memory region for LLEXT heap.

config MAIN_STACK_REGION
	string "Main stack memory region"
	depends on CODE_DATA_RELOCATION
	help
	  Specify the memory region for main stack.

config ARDUINO_SKETCH_LOADER_FS
	bool "Load the sketch as an llext from a file system path"
	depends on LLEXT && FILE_SYSTEM
	help
	  Replace the default flash-partition sketch loader with one that
	  opens a file on a mounted file system (e.g. SD-FAT) via Zephyr's
	  llext fs_loader. Use this on targets with no internal flash, such
	  as the Raspberry Pi family boards.

config ARDUINO_SKETCH_LOADER_FS_PATH
	string "Sketch file system path"
	depends on ARDUINO_SKETCH_LOADER_FS
	default "/SD:/sketch.llext"
	help
	  Absolute path to the sketch .llext file on the mounted file system.

config ARDUINO_SKETCH_LOADER_CDC_UPLOAD
	bool "In-process CDC upload + swap (no reboot)"
	depends on ARDUINO_SKETCH_LOADER_FS && USB_DEVICE_STACK_NEXT && USBD_CDC_ACM_CLASS
	select RING_BUFFER
	select UART_LINE_CTRL
	help
	  The loader owns USBD/CDC: it brings USB up at boot, runs the sketch in
	  its own thread, and watches the CDC line for the IDE's 1200-bps upload
	  touch. On the touch it aborts the sketch, receives a fresh sketch.llext
	  over CDC, writes it to the (firmware-owned) file system, and starts it
	  in-process -- no reboot. For SoCs with no sys_reboot, such as the
	  BCM2710 / Raspberry Pi Zero 2 W. Pairs with CONFIG_ARDUINO_USB_LOADER_OWNED
	  on the sketch side.
```
